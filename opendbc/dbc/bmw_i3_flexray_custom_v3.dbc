VERSION "BMW i3 FlexRay custom draft v3"

NS_ :

BS_:

BU_: BMW_I3

CM_ "Draft DBC derived from BMW i3 FlexRay and PT-CAN logs. Address 27 was not observed in any uploaded segment. Signals below intentionally mix three classes: confirmed parse signals already used by CarState, state/proxy helpers useful for reverse engineering, and unresolved TX candidates kept for shadow-debug correlation.";

BO_ 46 WHEEL_SPEED: 17 BMW_I3
 SG_ RL_SPEED_RAW : 24|16@1+ (0.015625,-511.984375) [0|65535] "kph" BMW_I3
 SG_ RR_SPEED_RAW : 40|16@1+ (0.015625,-511.984375) [0|65535] "kph" BMW_I3
 SG_ FL_SPEED_RAW : 56|16@1+ (0.015625,-511.984375) [0|65535] "kph" BMW_I3
 SG_ FR_SPEED_RAW : 72|16@1+ (0.015625,-511.984375) [0|65535] "kph" BMW_I3
 CM_ BO_ 46 "Confirmed BMW-style wheel-speed helper aligned with the SP2018 bit layout. Wheel speeds remain the secondary/fallback vehicle-speed source in current CarState.";

BO_ 49 STEER_TORQUE: 17 BMW_I3
 SG_ STEER_TORQUE_CYCLE_RAW : 0|8@1+ (1,0) [0|255] "" BMW_I3
 SG_ DRIVER_STEER_TORQUE_BMW : 24|12@1+ (0.005,-10) [-10|10.475] "Nm" BMW_I3
 SG_ STEER_TORQUE_STATUS_RAW : 24|8@1+ (1,0) [0|255] "" BMW_I3
 CM_ BO_ 49 "Confirmed steering-torque helper. BMW-style driver torque lives in the 24|12 field and is valid on the cycle-0 subframe. CarState uses this path for steeringTorque/steeringPressed.";

BO_ 51 EPS_ANGLE: 17 BMW_I3
 SG_ STEERING_ANGLE_RAW : 8|16@1- (0.1,0) [-1000|1000] "deg" BMW_I3
 SG_ EPS_STATUS_RAW : 24|8@1+ (1,0) [0|255] "" BMW_I3
 CM_ BO_ 51 "Confirmed EPS-angle helper. This is the primary steering-angle source used by CarState and by shadow lateral debug comparisons.";

BO_ 55 VEHICLE_SPEED_PROV: 17 BMW_I3
 SG_ VEHICLE_SPEED_CYCLE_RAW M : 0|2@1+ (1,0) [0|3] "" BMW_I3
 SG_ LONG_ACCEL_RAW m0 : 24|16@1+ (0.002,-65) [0|65535] "" BMW_I3
 SG_ VEHICLE_SPEED_BMW m3 : 24|16@1+ (0.015625,0) [0|65535] "kph" BMW_I3
 SG_ DRIVING_STATUS_BMW m3 : 44|2@1+ (1,0) [0|7] "" BMW_I3
 CM_ BO_ 55 "Confirmed primary vehicle-speed source aligned with the BMW SP2018 multiplexed layout. CarState now consumes the m3 vehicle-speed subframe and keeps frame 46 only as fallback/support.";

BO_ 56 DYNAMICS_YAW_PROV: 17 BMW_I3
 SG_ YAW_RATE_RAW_A : 8|16@1- (0.01,0) [-500|500] "deg/s" BMW_I3
 SG_ YAW_RATE_RAW_B : 24|16@1- (0.01,0) [-500|500] "deg/s" BMW_I3
 CM_ BO_ 56 "Confirmed vehicle-dynamics helper. Raw yaw fields are used for reverse-engineering correlation, especially while comparing stock lateral behavior against shadow steering logic.";

BO_ 40 DRIVE_STATE_EXPERIMENTAL: 17 BMW_I3
 SG_ DRIVE_STATE_CYCLE_COMPAT : 0|2@1+ (1,0) [0|3] "" BMW_I3
 SG_ DRIVE_STATE_RAW : 8|16@1+ (1,0) [0|65535] "" BMW_I3
  SG_ DRIVE_MODE_RAW : 24|8@1+ (1,0) [0|255] "" BMW_I3
 SG_ DRIVE_STATE_GEAR_M3_COMPAT : 24|4@1+ (1,0) [0|15] "" BMW_I3
 SG_ DRIVE_STATE_P_LOCKED_M3_COMPAT : 49|1@1+ (1,0) [0|1] "" BMW_I3
 SG_ DRIVE_STATE_KIND_BYTE_11 : 88|8@1+ (1,0) [0|255] "" BMW_I3
 SG_ DRIVE_STATE_KIND_BYTE_14 : 112|8@1+ (1,0) [0|255] "" BMW_I3
 CM_ BO_ 40 "Experimental drive-state frame. Cross-check against dynm BMW SP2018 FlexRay DBC shows this frame is the closest local match to their maybe_gear_switch frame, so helper signals for cycle_count, GEAR m3, and P_locked m3 are exposed here for analysis. Current i3 parked routes do not yet separate P/D/N/R robustly enough to use these helpers directly in CarState.";

BO_ 44 BRAKE_OR_REGEN_CANDIDATE_A: 17 BMW_I3
 SG_ BRAKE_REGEN_STATE_A : 8|16@1+ (1,0) [0|65535] "" BMW_I3
 SG_ BRAKE_REGEN_STATE_B : 24|16@1+ (1,0) [0|65535] "" BMW_I3
 CM_ SG_ 44 BRAKE_REGEN_STATE_A "Experimental secondary longitudinal candidate. Across historical TJA routes 00000054/55 and modern ACC-only route 000000b3, this frame separates dynamic phases weakly but remains far less informative than 54 and 59 for manual pedal vs managed-following behavior.";

BO_ 54 BRAKE_BLEND_CANDIDATE_B: 17 BMW_I3
 SG_ BRAKE_BLEND_STATE_A : 8|16@1+ (1,0) [0|65535] "" BMW_I3
 SG_ BRAKE_BLEND_STATE_B : 24|16@1+ (1,0) [0|65535] "" BMW_I3
 SG_ BRAKE_BLEND_STATE_C : 40|16@1+ (1,0) [0|65535] "" BMW_I3
 SG_ LONG_TX_BRAKE_BLEND_WORD_B : 24|16@1+ (1,0) [0|65535] "" BMW_I3
 SG_ LONG_TX_BRAKE_BLEND_WORD_C : 40|16@1+ (1,0) [0|65535] "" BMW_I3
 SG_ BRAKE_BLEND_BYTE_3 : 24|8@1+ (1,0) [0|255] "" BMW_I3
 SG_ BRAKE_BLEND_BYTE_4 : 32|8@1+ (1,0) [0|255] "" BMW_I3
 SG_ BRAKE_BLEND_BYTE_5 : 40|8@1+ (1,0) [0|255] "" BMW_I3
 SG_ BRAKE_BLEND_BYTE_6 : 48|8@1+ (1,0) [0|255] "" BMW_I3
 SG_ LONG_TX_BRAKE_BLEND_BYTE_4 : 32|8@1+ (1,0) [0|255] "" BMW_I3
 SG_ LONG_TX_BRAKE_BLEND_BYTE_6 : 48|8@1+ (1,0) [0|255] "" BMW_I3
CM_ SG_ 54 BRAKE_BLEND_STATE_A "Primary brake-blend / regen-support candidate. Across 00000054, 00000055, modern ACC-only route 000000b3, and recent ACC-only route 00000147, this frame cleanly separates manual accelerator application, ACC armed/base, and managed/following phases. STATE_B and STATE_C rise strongly in managed-following and automatic decel windows. In 00000147, frame 54 becomes active in complementary subframes while 59 carries the powertrain-intent side, reinforcing that 54 is the best current stock longitudinal support frame for brake-blend / regen behavior rather than a standalone brake command.";

BO_ 59 PEDAL_OR_HOLD_STATE_CANDIDATE: 17 BMW_I3
 SG_ PEDAL_HOLD_STATE_RAW : 16|16@1+ (1,0) [0|65535] "" BMW_I3
 SG_ PEDAL_HOLD_STATE_AUX : 32|16@1+ (1,0) [0|65535] "" BMW_I3
 SG_ PEDAL_HOLD_BYTE_2 : 16|8@1+ (1,0) [0|255] "" BMW_I3
 SG_ PEDAL_HOLD_BYTE_3 : 24|8@1+ (1,0) [0|255] "" BMW_I3
 SG_ PEDAL_HOLD_BYTE_4 : 32|8@1+ (1,0) [0|255] "" BMW_I3
 SG_ PEDAL_HOLD_BYTE_5 : 40|8@1+ (1,0) [0|255] "" BMW_I3
 SG_ LONG_TX_POWERTRAIN_WORD_B : 24|16@1+ (1,0) [0|65535] "" BMW_I3
 SG_ LONG_TX_POWERTRAIN_WORD_C : 40|16@1+ (1,0) [0|65535] "" BMW_I3
 SG_ LONG_TX_POWERTRAIN_BYTE_3 : 24|8@1+ (1,0) [0|255] "" BMW_I3
 SG_ LONG_TX_POWERTRAIN_BYTE_5 : 40|8@1+ (1,0) [0|255] "" BMW_I3
CM_ SG_ 59 PEDAL_HOLD_STATE_RAW "Strongest stock longitudinal content candidate so far. Across 00000054, 00000055, 000000b3, and recent ACC-only route 00000147, RAW is high during clear manual accelerator application, lower in ACC armed/base, and lowest during managed/following windows. AUX also shifts strongly between manual and managed phases. In 00000147 managed ACC, 59 remains the dominant powertrain-intent family while 54 appears in complementary brake-blend subframes. This remains the best current candidate for stock pedal/hold/coast-state inference under ACC, not a closed accel command.";

BO_ 72 LAT_STOCK_TX_CANDIDATE: 17 BMW_I3
 SG_ LAT_STOCK_TX_PHASE_BYTE_0 : 0|8@1+ (1,0) [0|255] "" BMW_I3
 SG_ LAT_STOCK_TX_CNT_NIBBLE : 16|4@1+ (1,0) [0|15] "" BMW_I3
 SG_ LAT_STOCK_TX_CONST_F_NIBBLE : 20|4@1+ (1,0) [0|15] "" BMW_I3
 SG_ LAT_STOCK_TX_FLAG_BYTE_8 : 64|8@1+ (1,0) [0|255] "" BMW_I3
CM_ BO_ 72 "Primary lateral TX envelope candidate. Modern routes 000000e9 and 000000ea strongly suggest src0/72 is the stock steering-control transmit family. Useful content appears in odd phase subframes only. Re-analysis against dynm BMW SP2018 semantics shows byte2 is not a steer command; it splits into a rolling low-nibble counter and a constant high nibble 0xF, while byte8 remains fixed at 0xE0. Historical dynm BMW SP2018 DBC also labels frame 72 as ACC steering control. The container is likely correct, but the actual steer payload is still unresolved.";

BO_ 43 CHASSIS_STATE_CANDIDATE: 17 BMW_I3
 SG_ CHASSIS_STATE_A : 8|16@1+ (1,0) [0|65535] "" BMW_I3
 SG_ CHASSIS_STATE_B : 24|16@1+ (1,0) [0|65535] "" BMW_I3
 CM_ SG_ 43 CHASSIS_STATE_A "Experimental secondary dynamic-state frame. It follows longitudinal phase changes across 00000054/55/b3, but is still weaker than 59 and 54 for isolating stock ACC content.";

BO_ 93 ACC_TJA_OLD_ROUTE_HELPER_A: 17 BMW_I3
 SG_ ACC_TJA_OLD_A_CYCLE : 0|8@1+ (1,0) [0|255] "" BMW_I3
 SG_ ACC_TJA_OLD_A_WORD_A : 8|16@1+ (1,0) [0|65535] "" BMW_I3
 SG_ ACC_TJA_OLD_A_WORD_B : 24|16@1+ (1,0) [0|65535] "" BMW_I3
 SG_ ACC_TJA_OLD_A_WORD_C : 40|16@1+ (1,0) [0|65535] "" BMW_I3
 SG_ ACC_TJA_OLD_A_WORD_D : 56|16@1+ (1,0) [0|65535] "" BMW_I3
 SG_ ACC_TJA_OLD_STATE_MAIN_A : 40|16@1+ (1,0) [0|65535] "" BMW_I3
 CM_ BO_ 93 "Experimental helper from legacy multi-segment TJA routes 00000054/55/56. This src23 frame repeatedly changed around ACC/TJA/stalk command windows and is kept as a raw helper only for old-route correlation.";

BO_ 96 LAT_STOCK_TX_PAYLOAD_CANDIDATE: 9 BMW_I3
 SG_ LAT_STOCK_TX_PAYLOAD_BYTE_0 : 0|8@1+ (1,0) [0|255] "" BMW_I3
 SG_ LAT_STOCK_TX_PAYLOAD_BYTE_1 : 8|8@1+ (1,0) [0|255] "" BMW_I3
 SG_ LAT_STOCK_TX_PAYLOAD_BYTE_2 : 16|8@1+ (1,0) [0|255] "" BMW_I3
 SG_ LAT_STOCK_TX_PAYLOAD_BYTE_3 : 24|8@1+ (1,0) [0|255] "" BMW_I3
 SG_ LAT_STOCK_TX_PAYLOAD_BYTE_4 : 32|8@1+ (1,0) [0|255] "" BMW_I3
 SG_ LAT_STOCK_TX_PAYLOAD_BYTE_8 : 64|8@1+ (1,0) [0|255] "" BMW_I3
CM_ BO_ 96 "Primary lateral TX payload candidate. Modern routes 000000e9 and 000000ea show src0/96 changing coherently during TJA left/right steering windows while src0/72 behaves like the outer TX phase/counter envelope. This frame is the best current candidate for the actual stock lateral TX payload, but command semantics are still unresolved.";

BO_ 97 ACC_TJA_OLD_ROUTE_HELPER_B: 17 BMW_I3
 SG_ ACC_TJA_OLD_B_CYCLE : 0|8@1+ (1,0) [0|255] "" BMW_I3
 SG_ ACC_TJA_OLD_B_WORD_A : 8|16@1+ (1,0) [0|65535] "" BMW_I3
 SG_ ACC_TJA_OLD_B_WORD_B : 24|16@1+ (1,0) [0|65535] "" BMW_I3
 SG_ ACC_TJA_OLD_B_WORD_C : 40|16@1+ (1,0) [0|65535] "" BMW_I3
 SG_ ACC_TJA_OLD_B_WORD_D : 56|16@1+ (1,0) [0|65535] "" BMW_I3
 SG_ ACC_TJA_OLD_STALK_MAIN_A : 8|16@1+ (1,0) [0|65535] "" BMW_I3
 SG_ ACC_TJA_OLD_STALK_MAIN_B : 24|16@1+ (1,0) [0|65535] "" BMW_I3
 CM_ BO_ 97 "Experimental helper from legacy multi-segment TJA routes 00000054/55/56. This src23 frame is one of the strongest recurring candidates for ACC/TJA/stalk command state and is exposed raw for old-route analysis.";

BO_ 102 COLUMN_SWITCH_CANDIDATE: 17 BMW_I3
 SG_ COLUMN_SWITCH_WORD_A : 8|16@1+ (1,0) [0|65535] "" BMW_I3
 SG_ COLUMN_SWITCH_WORD_B : 24|16@1+ (1,0) [0|65535] "" BMW_I3
 SG_ COLUMN_SWITCH_WORD_C : 40|16@1+ (1,0) [0|65535] "" BMW_I3
 SG_ COLUMN_SWITCH_WORD_D : 56|16@1+ (1,0) [0|65535] "" BMW_I3
 CM_ BO_ 102 "Experimental column-switch / indicator candidate. In the parked command-isolation route, this frame changed clearly during right/left indicator windows and also moved with some ACC/TJA button presses. Treat as a likely steering-column input frame rather than pure ADAS state.";

BO_ 110 ACC_TJA_OLD_ROUTE_HELPER_C: 17 BMW_I3
 SG_ ACC_TJA_OLD_C_CYCLE : 0|8@1+ (1,0) [0|255] "" BMW_I3
 SG_ ACC_TJA_OLD_C_WORD_A : 8|16@1+ (1,0) [0|65535] "" BMW_I3
 SG_ ACC_TJA_OLD_C_WORD_B : 24|16@1+ (1,0) [0|65535] "" BMW_I3
 SG_ ACC_TJA_OLD_C_WORD_C : 40|16@1+ (1,0) [0|65535] "" BMW_I3
 SG_ ACC_TJA_OLD_C_WORD_D : 56|16@1+ (1,0) [0|65535] "" BMW_I3
 CM_ BO_ 110 "Experimental helper from legacy multi-segment TJA routes 00000054/55/56. This src23 frame moved with speed-stalk and ACC transitions often enough to warrant a raw helper block.";

BO_ 106 ACC_STALK_TJA_CANDIDATE_A: 17 BMW_I3
 SG_ ACC_STALK_TJA_WORD_A : 8|16@1+ (1,0) [0|65535] "" BMW_I3
 SG_ ACC_STALK_TJA_WORD_B : 24|16@1+ (1,0) [0|65535] "" BMW_I3
 SG_ ACC_STALK_TJA_WORD_C : 40|16@1+ (1,0) [0|65535] "" BMW_I3
 SG_ ACC_STALK_TJA_WORD_D : 56|16@1+ (1,0) [0|65535] "" BMW_I3
 CM_ BO_ 106 "Experimental ACC/TJA candidate from TJA and parked command-isolation routes. Changed coherently around SET, RES, ACC, TJA, speed-stalk increment/decrement, distance-button, and ACC off windows. Byte pair around bits 24..39 stayed stable enough for comparison across sessions, but no clean bit-level interpretation is confirmed yet.";

BO_ 112 ACC_STALK_TJA_CANDIDATE_B: 17 BMW_I3
 SG_ ACC_STALK_TJA_B_WORD_A : 8|16@1+ (1,0) [0|65535] "" BMW_I3
 SG_ ACC_STALK_TJA_B_WORD_B : 24|16@1+ (1,0) [0|65535] "" BMW_I3
 SG_ ACC_STALK_TJA_B_WORD_C : 40|16@1+ (1,0) [0|65535] "" BMW_I3
 SG_ ACC_STALK_TJA_B_WORD_D : 56|16@1+ (1,0) [0|65535] "" BMW_I3
 SG_ LAT_STOCK_MAIN_BYTE_0 : 0|8@1+ (1,0) [0|255] "" BMW_I3
 SG_ LAT_STOCK_MAIN_BYTE_1 : 8|8@1+ (1,0) [0|255] "" BMW_I3
 SG_ LAT_STOCK_MAIN_WORD_A : 8|16@1+ (1,0) [0|65535] "" BMW_I3
 SG_ LAT_STOCK_MAIN_WORD_B : 24|16@1+ (1,0) [0|65535] "" BMW_I3
 SG_ LAT_STOCK_MAIN_WORD_C : 40|16@1+ (1,0) [0|65535] "" BMW_I3
 SG_ LAT_STOCK_MAIN_WORD_D : 56|16@1+ (1,0) [0|65535] "" BMW_I3
 SG_ LAT_STOCK_MAIN_BYTE_5 : 40|8@1+ (1,0) [0|255] "" BMW_I3
 SG_ LAT_STOCK_ACTIVE_HINT : 45|1@1+ (1,0) [0|1] "" BMW_I3
CM_ BO_ 112 "Primary lateral RX/state helper. Confirmed on historical routes 00000054 and 00000055 and present on the modern interface in route 000000b3. Historical logs exposed it on src24; modern dual-FlexRay logging exposes the same frame on src1. It changes cleanly between manual driving, ACC-base, and TJA-assisted steering windows and is the best current candidate for reverse-engineering stock lateral control state/content. Bit-level analysis shows byte5 bit5 is the strongest manual/off vs assisted discriminator: off/manual tends to set the bit (byte5=0x2b), assisted steering tends to clear it (byte5=0x0b).";

BO_ 116 ACC_STALK_TJA_CANDIDATE_C: 17 BMW_I3
 SG_ ACC_STALK_TJA_C_WORD_A : 8|16@1+ (1,0) [0|65535] "" BMW_I3
 SG_ ACC_STALK_TJA_C_WORD_B : 24|16@1+ (1,0) [0|65535] "" BMW_I3
 SG_ ACC_STALK_TJA_C_WORD_C : 40|16@1+ (1,0) [0|65535] "" BMW_I3
 SG_ ACC_STALK_TJA_C_WORD_D : 56|16@1+ (1,0) [0|65535] "" BMW_I3
 SG_ LAT_STOCK_SUPPORT_WORD_A : 8|16@1+ (1,0) [0|65535] "" BMW_I3
 SG_ LAT_STOCK_SUPPORT_WORD_B : 24|16@1+ (1,0) [0|65535] "" BMW_I3
 SG_ LAT_STOCK_SUPPORT_WORD_C : 40|16@1+ (1,0) [0|65535] "" BMW_I3
 SG_ LAT_STOCK_SUPPORT_WORD_D : 56|16@1+ (1,0) [0|65535] "" BMW_I3
 SG_ LAT_STOCK_SUPPORT_BYTE_1 : 8|8@1+ (1,0) [0|255] "" BMW_I3
 SG_ LAT_STOCK_SUPPORT_BYTE_2 : 16|8@1+ (1,0) [0|255] "" BMW_I3
 SG_ LAT_STOCK_SUPPORT_BYTE_5 : 40|8@1+ (1,0) [0|255] "" BMW_I3
CM_ BO_ 116 "Secondary lateral RX/state helper. Confirmed on historical routes 00000054 and 00000055 and present on the modern interface in route 000000b3. Historical logs exposed it on src23; modern dual-FlexRay logging exposes the same frame on src1. It tracks the same assisted-steering phases as 112 and is the best current secondary helper for stock lateral command/echo analysis. Bit-level analysis did not produce a single robust boolean, but bytes 1-2 and byte5 move through stable phase families during assisted steering and are the best fields for future extraction.";

BO_ 124 ACC_STALK_TJA_CANDIDATE_D: 17 BMW_I3
 SG_ ACC_STALK_TJA_D_WORD_A : 8|16@1+ (1,0) [0|65535] "" BMW_I3
 SG_ ACC_STALK_TJA_D_WORD_B : 24|16@1+ (1,0) [0|65535] "" BMW_I3
 SG_ ACC_STALK_TJA_D_WORD_C : 40|16@1+ (1,0) [0|65535] "" BMW_I3
 SG_ ACC_STALK_TJA_D_WORD_D : 56|16@1+ (1,0) [0|65535] "" BMW_I3
 CM_ BO_ 124 "Experimental ACC/TJA candidate from TJA and parked command-isolation routes. Strongly correlated with SET, RES, ACC, TJA, speed-stalk increment/decrement, distance-button, and ACC off. This frame is a priority candidate for future bit-level extraction of ACC/TJA state.";

BO_ 131 ACC_TJA_OLD_ROUTE_HELPER_D: 17 BMW_I3
 SG_ ACC_TJA_OLD_D_CYCLE : 0|8@1+ (1,0) [0|255] "" BMW_I3
 SG_ ACC_TJA_OLD_D_WORD_A : 8|16@1+ (1,0) [0|65535] "" BMW_I3
 SG_ ACC_TJA_OLD_D_WORD_B : 24|16@1+ (1,0) [0|65535] "" BMW_I3
 SG_ ACC_TJA_OLD_D_WORD_C : 40|16@1+ (1,0) [0|65535] "" BMW_I3
 SG_ ACC_TJA_OLD_D_WORD_D : 56|16@1+ (1,0) [0|65535] "" BMW_I3
 SG_ ACC_TJA_OLD_CTRL_GATE : 40|16@1+ (1,0) [0|65535] "" BMW_I3
 SG_ ACC_LONG_GATE_STATE : 40|16@1+ (1,0) [0|65535] "" BMW_I3
CM_ BO_ 131 "Primary longitudinal state/gate helper. Across legacy TJA routes 00000054/55/56, modern ACC-only route 000000b3, and recent ACC-only route 00000147, this frame separates OFF (643), ACC base armed/ready state (3584), transition into managed (640 with 135=26850), and managed/following assist states (640/656 with 135=24802). Best current gate/state coarse indicator for stock ACC behavior.";

BO_ 135 ACC_TJA_OLD_ROUTE_HELPER_E: 17 BMW_I3
 SG_ ACC_TJA_OLD_E_CYCLE : 0|8@1+ (1,0) [0|255] "" BMW_I3
 SG_ ACC_TJA_OLD_E_WORD_A : 8|16@1+ (1,0) [0|65535] "" BMW_I3
 SG_ ACC_TJA_OLD_E_WORD_B : 24|16@1+ (1,0) [0|65535] "" BMW_I3
 SG_ ACC_TJA_OLD_E_WORD_C : 40|16@1+ (1,0) [0|65535] "" BMW_I3
 SG_ ACC_TJA_OLD_E_WORD_D : 56|16@1+ (1,0) [0|65535] "" BMW_I3
 SG_ ACC_TJA_OLD_CTRL_STATE : 40|16@1+ (1,0) [0|65535] "" BMW_I3
 SG_ ACC_LONG_MAIN_STATE : 40|16@1+ (1,0) [0|65535] "" BMW_I3
CM_ BO_ 135 "Primary longitudinal main-state helper. Across legacy TJA routes 00000054/55/56, modern ACC-only route 000000b3, and recent ACC-only route 00000147, this frame separates OFF (35041), ACC base armed/ready state (16610), transition into managed (26850), and managed/following assist state (24802). Best current stock ACC state indicator.";

BO_ 241 ACC_TJA_OLD_ROUTE_HELPER_F: 17 BMW_I3
 SG_ ACC_TJA_OLD_F_CYCLE : 0|8@1+ (1,0) [0|255] "" BMW_I3
 SG_ ACC_TJA_OLD_F_WORD_A : 8|16@1+ (1,0) [0|65535] "" BMW_I3
 SG_ ACC_TJA_OLD_F_WORD_B : 24|16@1+ (1,0) [0|65535] "" BMW_I3
 SG_ ACC_TJA_OLD_F_WORD_C : 40|16@1+ (1,0) [0|65535] "" BMW_I3
 SG_ ACC_TJA_OLD_F_WORD_D : 56|16@1+ (1,0) [0|65535] "" BMW_I3
 CM_ BO_ 241 "Experimental helper from legacy multi-segment TJA routes 00000054/55/56. Secondary command-related frame retained as raw helper for ACC/TJA comparison work.";

BO_ 250 ACC_TJA_OLD_ROUTE_HELPER_G: 17 BMW_I3
 SG_ ACC_TJA_OLD_G_CYCLE : 0|8@1+ (1,0) [0|255] "" BMW_I3
 SG_ ACC_TJA_OLD_G_WORD_A : 8|16@1+ (1,0) [0|65535] "" BMW_I3
 SG_ ACC_TJA_OLD_G_WORD_B : 24|16@1+ (1,0) [0|65535] "" BMW_I3
 SG_ ACC_TJA_OLD_G_WORD_C : 40|16@1+ (1,0) [0|65535] "" BMW_I3
 SG_ ACC_TJA_OLD_G_WORD_D : 56|16@1+ (1,0) [0|65535] "" BMW_I3
 CM_ BO_ 250 "Experimental helper from legacy multi-segment TJA routes 00000054/55/56. Strong secondary responder during SET/RES/ACC/TJA/speed-stalk windows; kept raw for old-route correlation.";

BO_ 256 ACC_STALK_TJA_CANDIDATE_E: 17 BMW_I3
 SG_ ACC_STALK_TJA_E_WORD_A : 8|16@1+ (1,0) [0|65535] "" BMW_I3
 SG_ ACC_STALK_TJA_E_WORD_B : 24|16@1+ (1,0) [0|65535] "" BMW_I3
 SG_ ACC_STALK_TJA_E_WORD_C : 40|16@1+ (1,0) [0|65535] "" BMW_I3
 CM_ BO_ 256 "Experimental ACC/TJA candidate from TJA and parked command-isolation routes. Small payload frame that changed consistently at SET, RES, ACC, TJA, speed-stalk increment/decrement, distance-button, blinker windows, and ACC off. Good candidate for compact command-state or resume-state signaling.";

BO_ 269 ACC_TJA_OLD_ROUTE_HELPER_H: 17 BMW_I3
 SG_ ACC_TJA_OLD_H_CYCLE : 0|8@1+ (1,0) [0|255] "" BMW_I3
 SG_ ACC_TJA_OLD_H_WORD_A : 8|16@1+ (1,0) [0|65535] "" BMW_I3
 SG_ ACC_TJA_OLD_H_WORD_B : 24|16@1+ (1,0) [0|65535] "" BMW_I3
 SG_ ACC_TJA_OLD_H_WORD_C : 40|16@1+ (1,0) [0|65535] "" BMW_I3
 SG_ ACC_TJA_OLD_H_WORD_D : 56|16@1+ (1,0) [0|65535] "" BMW_I3
 CM_ BO_ 269 "Experimental helper from legacy multi-segment TJA routes 00000054/55/56. Src13 frame that reacts strongly near ACC/TJA engagement and manual intervention windows.";

BO_ 271 ACC_TJA_OLD_ROUTE_HELPER_I: 17 BMW_I3
 SG_ ACC_TJA_OLD_I_CYCLE : 0|8@1+ (1,0) [0|255] "" BMW_I3
 SG_ ACC_TJA_OLD_I_WORD_A : 8|16@1+ (1,0) [0|65535] "" BMW_I3
 SG_ ACC_TJA_OLD_I_WORD_B : 24|16@1+ (1,0) [0|65535] "" BMW_I3
 SG_ ACC_TJA_OLD_I_WORD_C : 40|16@1+ (1,0) [0|65535] "" BMW_I3
 SG_ ACC_TJA_OLD_I_WORD_D : 56|16@1+ (1,0) [0|65535] "" BMW_I3
 CM_ BO_ 271 "Experimental helper from legacy multi-segment TJA routes 00000054/55/56. Src13 frame that follows the same command-family transitions as 135/97/116/112/275, but with weaker consistency.";

BO_ 275 ACC_STALK_TJA_CANDIDATE_F: 17 BMW_I3
 SG_ ACC_STALK_TJA_F_WORD_A : 8|16@1+ (1,0) [0|65535] "" BMW_I3
 SG_ ACC_STALK_TJA_F_WORD_B : 24|16@1+ (1,0) [0|65535] "" BMW_I3
 SG_ ACC_STALK_TJA_F_WORD_C : 40|16@1+ (1,0) [0|65535] "" BMW_I3
 SG_ ACC_STALK_TJA_F_WORD_D : 56|16@1+ (1,0) [0|65535] "" BMW_I3
 SG_ LAT_STOCK_CONFIRM_WORD_A : 8|16@1+ (1,0) [0|65535] "" BMW_I3
 SG_ LAT_STOCK_CONFIRM_WORD_B : 24|16@1+ (1,0) [0|65535] "" BMW_I3
 SG_ LAT_STOCK_CONFIRM_WORD_C : 40|16@1+ (1,0) [0|65535] "" BMW_I3
 SG_ LAT_STOCK_CONFIRM_WORD_D : 56|16@1+ (1,0) [0|65535] "" BMW_I3
 CM_ BO_ 275 "Stock lateral/TJA confirmation helper confirmed on historical routes 00000054 and 00000055 and present on the modern interface in route 000000b3. Historical logs exposed it on src23; modern dual-FlexRay logging exposes the same frame on src1. It is less clean than 112 and 116 but moves consistently with assisted-steering phases and is useful as a third correlation frame.";

BO_ 217 PTCAN_ACCELERATOR_CANDIDATE: 8 BMW_I3
 SG_ ACCEL_RAW_PT_CAN : 0|16@1+ (1,0) [0|65535] "" BMW_I3
 SG_ ACCEL_BYTE_0_PT_CAN : 0|8@1+ (1,0) [0|255] "" BMW_I3
 SG_ ACCEL_BYTE_1_PT_CAN : 8|8@1+ (1,0) [0|255] "" BMW_I3
 SG_ ACCELERATOR_I4_COMPAT_PT_CAN : 16|12@1+ (0.000244,0) [0|2047] "" BMW_I3
CM_ BO_ 217 "Confirmed PT-CAN accelerator-family frame in current CarState, while still retaining raw helper signals for reverse work. The first 16 bits changed strongly during the two isolated accelerator presses and stayed comparatively stable elsewhere. Cross-check against smnogar BMW i4 SP2018 DBC showed that bits 16|12 also behave like an accelerator field on the i3 routes.";

BO_ 239 PTCAN_CRUISE_BUTTONS_AUX: 8 BMW_I3
 SG_ CRUISE_BTN_AUX_PT_CAN : 0|16@1+ (1,0) [0|65535] "" BMW_I3
 SG_ CRUISE_BTN_AUX_BYTE_0 : 0|8@1+ (1,0) [0|255] "" BMW_I3
 SG_ CRUISE_BTN_AUX_BYTE_1 : 8|8@1+ (1,0) [0|255] "" BMW_I3
 SG_ BRAKE_PEDAL_I4_COMPAT_PT_CAN : 40|12@1+ (-1,3328) [0|3328] "" BMW_I3
CM_ BO_ 239 "Experimental PT-CAN candidate from parked command-isolation routes. The first 16 bits changed distinctly across SET, RES, and distance-button presses. Cross-check against smnogar BMW i4 SP2018 DBC showed that bits 40|12 stay pinned near 3328 on current i3 brake routes, so this frame should remain a cruise-button support frame on CAN src 2, not the primary brake signal.";

BO_ 274 PTCAN_BLINKER_STATE_CANDIDATE: 8 BMW_I3
 SG_ BLINKER_STATE_WORD0_PT_CAN : 0|16@1+ (1,0) [0|65535] "" BMW_I3
 SG_ BLINKER_STATE_BYTE_0 : 0|8@1+ (1,0) [0|255] "" BMW_I3
 SG_ BLINKER_STATE_BYTE_2 : 16|8@1+ (1,0) [0|255] "" BMW_I3
 SG_ BLINKER_STATE_BYTE_4 : 32|8@1+ (1,0) [0|255] "" BMW_I3
 SG_ BLINKER_STATE_BYTE_6 : 48|8@1+ (1,0) [0|255] "" BMW_I3
 SG_ BLINKER_STATE_BYTE_7 : 56|8@1+ (1,0) [0|255] "" BMW_I3
CM_ BO_ 274 "Confirmed PT-CAN state frame used by current CarState for blinkers and seatbelt, while still exposing raw helper bytes for reverse work. Byte 6 is the strongest current discriminator for left/right indicator state on src 2. Byte 7 separates the current seatbelt attached/unattached candidate on the same frame.";

BO_ 481 PTCAN_DRIVER_DOOR_CANDIDATE: 6 BMW_I3
 SG_ DRIVER_DOOR_STATE_BYTE_2 : 16|8@1+ (1,0) [0|255] "" BMW_I3
CM_ BO_ 481 "Confirmed PT-CAN driver-door frame in current CarState. Latest isolated parked door route and the previous two-open-close route both show byte 2 toggling cleanly between 0 (closed) and 1 (open) on src 2.";

BO_ 415 PTCAN_CRUISE_BUTTONS_MAIN: 8 BMW_I3
 SG_ CRUISE_BTN_MAIN_PT_CAN : 16|16@1+ (1,0) [0|65535] "" BMW_I3
 SG_ CRUISE_BTN_MAIN_BYTE_2 : 16|8@1+ (1,0) [0|255] "" BMW_I3
 SG_ CRUISE_BTN_MAIN_BYTE_3 : 24|8@1+ (1,0) [0|255] "" BMW_I3
CM_ BO_ 415 "Primary PT-CAN cruise-button frame. Bytes 2-3 changed cleanly across SET, RES, and distance-button presses with stable idle values, making this the best current main cruise-button source on CAN src 2. Current CarState uses this frame for SET/RES button events; +/- speed and distance semantics remain unresolved.";

BO_ 796 PTCAN_BRAKE_PRESSED_CANDIDATE: 8 BMW_I3
 SG_ BRAKE_PRESSED_RAW_PT_CAN : 0|16@1+ (1,0) [0|65535] "" BMW_I3
 SG_ BRAKE_PRESSED_BYTE_0_PT_CAN : 0|8@1+ (1,0) [0|255] "" BMW_I3
 SG_ BRAKE_PRESSED_BYTE_1_PT_CAN : 8|8@1+ (1,0) [0|255] "" BMW_I3
CM_ BO_ 796 "Confirmed PT-CAN brakePressed-family frame in current CarState, while raw helper bytes are still kept for reverse work. Byte 1 separates idle (~0x20..0x2E) from brake application (~0x00..0x0E), making it the strongest current brakePressed source on CAN src 2.";
