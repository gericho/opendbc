VERSION "BMW i3 FlexRay custom draft v3"

NS_ :

BS_:

BU_: BMW_I3

CM_ "Draft DBC derived from user's BMW i3 FlexRay logs. Address 27 was not observed in any uploaded segment. Signals below are a mix of confirmed, provisional, and experimental candidates.";

BO_ 46 WHEEL_SPEED: 17 BMW_I3
 SG_ FL_SPEED_RAW : 8|16@1+ (0.03125,0) [0|300] "kph" BMW_I3
 SG_ FR_SPEED_RAW : 24|16@1+ (0.03125,0) [0|300] "kph" BMW_I3
 SG_ RL_SPEED_RAW : 40|16@1+ (0.03125,0) [0|300] "kph" BMW_I3
 SG_ RR_SPEED_RAW : 56|16@1+ (0.03125,0) [0|300] "kph" BMW_I3

BO_ 49 STEER_TORQUE: 17 BMW_I3
 SG_ DRIVER_STEER_TORQUE_RAW : 8|16@1- (0.01,0) [-50|50] "Nm" BMW_I3
 SG_ STEER_TORQUE_STATUS_RAW : 24|8@1+ (1,0) [0|255] "" BMW_I3

BO_ 51 EPS_ANGLE: 17 BMW_I3
 SG_ STEERING_ANGLE_RAW : 8|16@1- (0.1,0) [-1000|1000] "deg" BMW_I3
 SG_ EPS_STATUS_RAW : 24|8@1+ (1,0) [0|255] "" BMW_I3

BO_ 55 VEHICLE_SPEED_PROV: 17 BMW_I3
 SG_ VEHICLE_SPEED_RAW_A : 8|16@1+ (0.03125,0) [0|300] "kph" BMW_I3
 SG_ VEHICLE_SPEED_RAW_B : 24|16@1+ (0.03125,0) [0|300] "kph" BMW_I3

BO_ 56 DYNAMICS_YAW_PROV: 17 BMW_I3
 SG_ YAW_RATE_RAW_A : 8|16@1- (0.01,0) [-500|500] "deg/s" BMW_I3
 SG_ YAW_RATE_RAW_B : 24|16@1- (0.01,0) [-500|500] "deg/s" BMW_I3

BO_ 40 DRIVE_STATE_EXPERIMENTAL: 17 BMW_I3
 SG_ DRIVE_STATE_RAW : 8|16@1+ (1,0) [0|65535] "" BMW_I3
 SG_ DRIVE_MODE_RAW : 24|8@1+ (1,0) [0|255] "" BMW_I3

BO_ 44 BRAKE_OR_REGEN_CANDIDATE_A: 17 BMW_I3
 SG_ BRAKE_REGEN_STATE_A : 8|16@1+ (1,0) [0|65535] "" BMW_I3
 SG_ BRAKE_REGEN_STATE_B : 24|16@1+ (1,0) [0|65535] "" BMW_I3
 CM_ SG_ 44 BRAKE_REGEN_STATE_A "Experimental. Address 44 changed between moving and stopped states, but did not cleanly isolate pedal-vs-regen by itself.";

BO_ 54 BRAKE_BLEND_CANDIDATE_B: 17 BMW_I3
 SG_ BRAKE_BLEND_STATE_A : 8|16@1+ (1,0) [0|65535] "" BMW_I3
 SG_ BRAKE_BLEND_STATE_B : 24|16@1+ (1,0) [0|65535] "" BMW_I3
 SG_ BRAKE_BLEND_STATE_C : 40|16@1+ (1,0) [0|65535] "" BMW_I3
 CM_ SG_ 54 BRAKE_BLEND_STATE_A "Experimental. Address 54 reacts during coast-to-regen transitions and automatic deceleration windows. In TJA logs, STATE_B/STATE_C changed more clearly during roundabout follow and release-of-accelerator windows than during steady manual pedal application, so this frame is a stronger brake-blend / regen-support candidate than address 44.";

BO_ 59 PEDAL_OR_HOLD_STATE_CANDIDATE: 17 BMW_I3
 SG_ PEDAL_HOLD_STATE_RAW : 16|16@1+ (1,0) [0|65535] "" BMW_I3
 SG_ PEDAL_HOLD_STATE_AUX : 32|16@1+ (1,0) [0|65535] "" BMW_I3
 CM_ SG_ 59 PEDAL_HOLD_STATE_RAW "Experimental but strongest pedal / coast / hold candidate from user logs. Across multiple TJA sessions, this field moved from high values during clear manual accelerator application to much lower values during release-to-regen and ACC-managed distance holding windows, making it the current best candidate for pedal-state or hold-state inference.";

BO_ 43 CHASSIS_STATE_CANDIDATE: 17 BMW_I3
 SG_ CHASSIS_STATE_A : 8|16@1+ (1,0) [0|65535] "" BMW_I3
 SG_ CHASSIS_STATE_B : 24|16@1+ (1,0) [0|65535] "" BMW_I3
 CM_ SG_ 43 CHASSIS_STATE_A "Experimental. Changes with dynamic state, but weaker than address 59 for brake-related hypotheses.";

BO_ 102 COLUMN_SWITCH_CANDIDATE: 17 BMW_I3
 SG_ COLUMN_SWITCH_WORD_A : 8|16@1+ (1,0) [0|65535] "" BMW_I3
 SG_ COLUMN_SWITCH_WORD_B : 24|16@1+ (1,0) [0|65535] "" BMW_I3
 SG_ COLUMN_SWITCH_WORD_C : 40|16@1+ (1,0) [0|65535] "" BMW_I3
 SG_ COLUMN_SWITCH_WORD_D : 56|16@1+ (1,0) [0|65535] "" BMW_I3
 CM_ BO_ 102 "Experimental column-switch / indicator candidate. In the parked command-isolation route, this frame changed clearly during right/left indicator windows and also moved with some ACC/TJA button presses. Treat as a likely steering-column input frame rather than pure ADAS state.";

BO_ 106 ACC_STALK_TJA_CANDIDATE_A: 17 BMW_I3
 SG_ ACC_STALK_TJA_WORD_A : 8|16@1+ (1,0) [0|65535] "" BMW_I3
 SG_ ACC_STALK_TJA_WORD_B : 24|16@1+ (1,0) [0|65535] "" BMW_I3
 SG_ ACC_STALK_TJA_WORD_C : 40|16@1+ (1,0) [0|65535] "" BMW_I3
 SG_ ACC_STALK_TJA_WORD_D : 56|16@1+ (1,0) [0|65535] "" BMW_I3
 CM_ BO_ 106 "Experimental ACC/TJA candidate from TJA and parked command-isolation routes. Changed coherently around SET, RES, ACC, TJA, speed-stalk increment/decrement, distance-button, and ACC off windows. Byte pair around bits 24..39 stayed stable enough for comparison across sessions, but no clean bit-level interpretation is confirmed yet.";

BO_ 112 ACC_STALK_TJA_CANDIDATE_B: 17 BMW_I3
 SG_ ACC_STALK_TJA_B_WORD_A : 8|16@1+ (1,0) [0|65535] "" BMW_I3
 SG_ ACC_STALK_TJA_B_WORD_B : 24|16@1+ (1,0) [0|65535] "" BMW_I3
 SG_ ACC_STALK_TJA_B_WORD_C : 40|16@1+ (1,0) [0|65535] "" BMW_I3
 SG_ ACC_STALK_TJA_B_WORD_D : 56|16@1+ (1,0) [0|65535] "" BMW_I3
 CM_ BO_ 112 "Experimental ACC/TJA candidate from TJA and parked command-isolation routes. This frame moved with the same event set as 106 and appears on src24, making it a good candidate for ADAS state or command echo on the ECU-side FlexRay group.";

BO_ 116 ACC_STALK_TJA_CANDIDATE_C: 17 BMW_I3
 SG_ ACC_STALK_TJA_C_WORD_A : 8|16@1+ (1,0) [0|65535] "" BMW_I3
 SG_ ACC_STALK_TJA_C_WORD_B : 24|16@1+ (1,0) [0|65535] "" BMW_I3
 SG_ ACC_STALK_TJA_C_WORD_C : 40|16@1+ (1,0) [0|65535] "" BMW_I3
 SG_ ACC_STALK_TJA_C_WORD_D : 56|16@1+ (1,0) [0|65535] "" BMW_I3
 CM_ BO_ 116 "Experimental ACC/TJA candidate from TJA and parked command-isolation routes. Changed with SET, RES, ACC, TJA, speed-stalk increment/decrement, distance-button, blinker windows, and ACC off. Likely related to driver-assistance command or command echo rather than pure vehicle dynamics.";

BO_ 124 ACC_STALK_TJA_CANDIDATE_D: 17 BMW_I3
 SG_ ACC_STALK_TJA_D_WORD_A : 8|16@1+ (1,0) [0|65535] "" BMW_I3
 SG_ ACC_STALK_TJA_D_WORD_B : 24|16@1+ (1,0) [0|65535] "" BMW_I3
 SG_ ACC_STALK_TJA_D_WORD_C : 40|16@1+ (1,0) [0|65535] "" BMW_I3
 SG_ ACC_STALK_TJA_D_WORD_D : 56|16@1+ (1,0) [0|65535] "" BMW_I3
 CM_ BO_ 124 "Experimental ACC/TJA candidate from TJA and parked command-isolation routes. Strongly correlated with SET, RES, ACC, TJA, speed-stalk increment/decrement, distance-button, and ACC off. This frame is a priority candidate for future bit-level extraction of ACC/TJA state.";

BO_ 256 ACC_STALK_TJA_CANDIDATE_E: 17 BMW_I3
 SG_ ACC_STALK_TJA_E_WORD_A : 8|16@1+ (1,0) [0|65535] "" BMW_I3
 SG_ ACC_STALK_TJA_E_WORD_B : 24|16@1+ (1,0) [0|65535] "" BMW_I3
 SG_ ACC_STALK_TJA_E_WORD_C : 40|16@1+ (1,0) [0|65535] "" BMW_I3
 CM_ BO_ 256 "Experimental ACC/TJA candidate from TJA and parked command-isolation routes. Small payload frame that changed consistently at SET, RES, ACC, TJA, speed-stalk increment/decrement, distance-button, blinker windows, and ACC off. Good candidate for compact command-state or resume-state signaling.";

BO_ 275 ACC_STALK_TJA_CANDIDATE_F: 17 BMW_I3
 SG_ ACC_STALK_TJA_F_WORD_A : 8|16@1+ (1,0) [0|65535] "" BMW_I3
 SG_ ACC_STALK_TJA_F_WORD_B : 24|16@1+ (1,0) [0|65535] "" BMW_I3
 SG_ ACC_STALK_TJA_F_WORD_C : 40|16@1+ (1,0) [0|65535] "" BMW_I3
 SG_ ACC_STALK_TJA_F_WORD_D : 56|16@1+ (1,0) [0|65535] "" BMW_I3
 CM_ BO_ 275 "Experimental ACC/TJA candidate from TJA and parked command-isolation routes. Most promising new control-state frame so far: it changed at SET, RES, ACC, TJA, speed-stalk increment/decrement, distance-button, multiple blinker windows, and ACC off. Treat as top candidate for stalk-command or ADAS command aggregation.";
